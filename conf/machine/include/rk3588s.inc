## conf/machine/include/rk3588s.inc
```bitbake
SOC_FAMILY ?= "rk3588s"
MACHINEOVERRIDES =. "rk3588s:"
DEFAULTTUNE ?= "cortexa76-cortexa55-crypto"

require conf/machine/include/arm/armv8-2a/tune-cortexa76-cortexa55.inc
```

## conf/machine/rock-5a.conf
```bitbake
#@TYPE: Machine
#@NAME: Radxa Rock 5A
#@DESCRIPTION: ROCK5 is the 5th generation of SBC designed by Radxa.
#https://docs.radxa.com/en/rock5/rock5a

require conf/machine/include/rk3588s.inc

#
# Kernel
#
#PREFERRED_PROVIDER_virtual/dtb = "devicetree-radxa"
#EXTERNAL_KERNEL_DEVICETREE = "bulleseye.dtb"

KERNEL_DEVICETREE = "rockchip/rk3588s-rock-5a.dtb"
MACHINE_EXTRA_RRECOMMENDS += "kernel-modules"
PREFERRED_PROVIDER_virtual/kernel = "linux-radxa"

SERIAL_CONSOLES = "1500000;ttyFIQ0"
KERNEL_IMAGETYPE = "Image"

KBUILD_DEFCONFIG = "rockchip_linux_defconfig"


#
# U-boot
#
UBOOT_MACHINE = "rock5a-rk3588s_defconfig"
PREFERRED_PROVIDER_virtual/bootloader = "u-boot-rockchip"
SPL_BINARY = "idbloader.img"
UBOOT_SUFFIX ?= "itb"


#
# Image
#
# Use systemd init manager
INIT_MANAGER = "systemd"

# No X11 rubbish
DISTRO_FEATURES:remove = "x11"

# Build a wic image
IMAGE_FSTYPES += "wic"
WKS_FILE = "image.wks"
ROOT_PARTUUID = "e9852d44-6984-472c-8845-9ad2ba36bfd2"
WICVARS:append = " SPL_BINARY UBOOT_SUFFIX ROOT_PARTUUID"

PREFERRED_PROVIDER_virtual/egl ?= "rockchip-libmali"
PREFERRED_PROVIDER_virtual/libgles1 ?= "rockchip-libmali"
PREFERRED_PROVIDER_virtual/libgles2 ?= "rockchip-libmali"
PREFERRED_PROVIDER_virtual/libgles3 ?= "rockchip-libmali"
PREFERRED_PROVIDER_virtual/libopencl ?= "rockchip-libmali"
PREFERRED_PROVIDER_virtual/libgbm ?= "rockchip-libmali"
```

## wic/image.wks
```
#
# idbloader / U-Boot SPL
#
part idbloader  --offset 32K  --fixed-size 4M --no-table --align 1 --source rawcopy --sourceparams="file=${SPL_BINARY}"

#
# U-Boot proper
#
part u-boot     --offset 8M   --fixed-size 4M --no-table --align 1 --source rawcopy --sourceparams="file=u-boot.${UBOOT_SUFFIX}"

#
# Partition Table (GPT)
#
#    Partition      Start      Size        Description
#    -----------    -------    --------    ----------------
#    config         12M        128M        config
#    /              140M       6G          rootfs (extended at bootup)
#    user           6284M      -           user (created at bootup)
#
part config     --offset 12M    --fixed-size 128M --label config --fstype=ext4 --part-name config --source bootimg-partition --align 1024
part /          --offset 140M   --label rootfs --active --fstype=ext4 --part-name rootfs --source rootfs --uuid="${ROOT_PARTUUID}" --align 1024

bootloader --ptable gpt
```
