## conf/layer.conf
```bitbake
# Released under the MIT license (see COPYING.MIT for the terms)

# Add conf and classes directory to BBPATH
BBPATH .= ":${LAYERDIR}"

# We have recipes-* directories, add to BBFILES
BBFILES += "${LAYERDIR}/recipes-*/*/*.bb ${LAYERDIR}/recipes-*/*/*.bbappend"

BBFILE_COLLECTIONS += "radxa"
BBFILE_PATTERN_radxa= "^${LAYERDIR}/"
BBFILE_PRIORITY_radxa= "8"

# This should only be incremented on significant changes that will
# cause compatibility issues with other layers
LAYERVERSION_radxa= "1"
LAYERSERIES_COMPAT_radxa= "scarthgap"
LAYERDEPENDS_radxa= "rockchip"
```
